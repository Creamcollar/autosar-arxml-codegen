AUTOSAR XML
package /GptPackage
  module config GptConfig: definition=Gpt
    GptConfigSet
      ecuc boolean param value GptConfigSetIncluded: value=true
    GptDriverConfiguration
      ecuc boolean param value GptDevErrorDetect: value=False
      ecuc boolean param value GptPredefTimer100us32bitEnable: value=False
      ecuc textual param value GptPredefTimer1usEnablingGrade: value=GPT_PREDEF_TIMER_1US_DISABLED
      ecuc boolean param value GptReportWakeupSource: value=False
    GptClockReferencePoint
      ecuc boolean param value GptClockReference: value=False
    GptChannelConfiguration
      ecuc numerical param value GptChannelId: value=0
      ecuc textual param value GptChannelMode: value=GPT_CH_MODE_CONTINUOUS
      ecuc numerical param value GptChannelTickFrequency: value=0
      ecuc numerical param value GptChannelTickValueMax: value=0
      ecuc boolean param value GptEnableWakeup: value=False
      ecuc textual param value GptNotification
      ecuc boolean param value GptChannelClkSrcRef: value=False
    GptChannelConfigSetValue
      ecuc numerical param value GptChannelConfigSetValue: value=0
    GptWakeupConfiguration
      ecuc boolean param value GptWakeupSourceRef: value=False
    GptConfigurationOfOptApiServices
      6 x ecuc boolean param value, all with value=False:
        GptDeinitApi
        GptEnableDisableNotificationApi
        GptTimeElapsedApi
        GptTimeRemainingApi
        GptVersionInfoApi
        GptWakeupFunctionalityApi
