AUTOSAR XML
package /AdcPackage
  module config AdcConfig: definition=Adc
    AdcConfigSet
      ecuc numerical param value AdcHwUnit: value=0
    AdcGeneral
      11 x ecuc boolean param value, all with value=False:
        AdcDeInitApi
        AdcDevErrorDetect
        AdcEnableLimitCheck
        AdcEnableQueuing
        AdcEnableStartStopGroupApi
        AdcGrpNotifCapability
        AdcHwTriggerApi
        AdcLowPowerStatesSupport
        AdcPowerStateAsynchTransitionMode
        AdcReadGroupApi
        AdcVersionInfoApi
      ecuc enumeration param value AdcPriorityImplementation: value=ADC_PRIORITY_NONE
      ecuc enumeration param value AdcResultAlignment: value=ADC_ALIGN_RIGHT
    AdcPowerStateConfig
      ecuc numerical param value AdcPowerState: value=0
      ecuc textual param value AdcPowerStateReadyCbkRef
    AdcChannel
      ecuc numerical param value AdcChannelConvTime: value=0
      ecuc numerical param value AdcChannelHighLimit: value=4095
      ecuc numerical param value AdcChannelId: value=0
      ecuc boolean param value AdcChannelLimitCheck: value=False
      ecuc numerical param value AdcChannelLowLimit: value=0
      ecuc enumeration param value AdcChannelRangeSelect: value=ADC_RANGE_ALWAYS
      ecuc boolean param value AdcChannelRefVoltsrcHigh: value=False
      ecuc boolean param value AdcChannelRefVoltsrcLow: value=False
      ecuc numerical param value AdcChannelResolution: value=10
      ecuc numerical param value AdcChannelSampTime: value=0
    AdcGroup
      ecuc enumeration param value AdcGroupAccessMode: value=ADC_ACCESS_MODE_SINGLE
      ecuc enumeration param value AdcGroupConversionMode: value=ADC_CONV_MODE_ONESHOT
      ecuc numerical param value AdcGroupId: value=0
      ecuc numerical param value AdcGroupPriority: value=0
      ecuc enumeration param value AdcGroupReplacement: value=ADC_GROUP_REPL_ABORT_RESTART
      ecuc enumeration param value AdcGroupTriggSrc: value=ADC_TRIGG_SRC_SW
      ecuc enumeration param value AdcHwTrigSignal: value=ADC_HW_TRIG_BOTH_EDGES
      ecuc numerical param value AdcHwTrigTimer: value=0
      ecuc boolean param value AdcNotification: value=False
      ecuc enumeration param value AdcStreamingBufferMode: value=ADC_STREAM_BUFFER_CIRCULAR
      ecuc numerical param value AdcStreamingNumSamples: value=1
      ecuc numerical param value AdcGroupDefinition: value=0
    AdcHwUnit
      ecuc boolean param value AdcClockSource: value=False
      ecuc numerical param value AdcHwUnitId: value=0
      ecuc numerical param value AdcPrescale: value=0
    AdcPublishedInformation
      ecuc boolean param value AdcChannelValueSigned: value=False
      ecuc boolean param value AdcGroupFirstChannelFixed: value=False
      ecuc numerical param value AdcMaxChannelResolution: value=0
