AUTOSAR XML
package /CanPackage
  CanConfigSet
    ecuc boolean param value CanConfigSetIncluded: value=true
  CanGeneral
    ecuc boolean param value CanDevErrorDetect: value=True
    ecuc boolean param value CanEnableSecurityEventReporting: value=False
    ecuc boolean param value CanGlobalTimeSupport: value=False
    ecuc numerical param value CanIndex: value=0
    ecuc textual param value CanLPduReceiveCalloutFunction
    4 x ecuc numerical param value:
      CanMainFunctionBusoffPeriod: value=100
      CanMainFunctionModePeriod: value=100
      CanMainFunctionWakeupPeriod: value=100
      CanMultiplexedTransmission: value=0
    ecuc boolean param value CanSetBaudrateApi: value=False
    ecuc numerical param value CanTimeoutDuration: value=100
    ecuc boolean param value CanVersionInfoApi: value=True
  CanController
    ecuc textual param value CanBusoffProcessing: value=INTERRUPT
    ecuc boolean param value CanControllerActivation: value=True
    ecuc numerical param value CanControllerBaseAddress: value=0
    ecuc numerical param value CanControllerId: value=0
    ecuc boolean param value CanHwPnSupport: value=False
    ecuc textual param value CanRxProcessing: value=INTERRUPT
    ecuc textual param value CanTxProcessing: value=INTERRUPT
    ecuc textual param value CanWakeupProcessing: value=INTERRUPT
    ecuc boolean param value CanWakeupSupport: value=False
  CanControllerBaudrateConfig
    6 x ecuc numerical param value:
      CanControllerBaudRate: value=500000
      CanControllerBaudRateConfigID: value=0
      CanControllerPropSeg: value=1
      CanControllerSeg1: value=1
      CanControllerSeg2: value=1
      CanControllerSyncJumpWidth: value=1
  CanControllerFdBaudrateConfig
    5 x ecuc numerical param value:
      CanControllerFdBaudRate: value=2000000
      CanControllerPropSeg: value=1
      CanControllerSeg1: value=1
      CanControllerSeg2: value=1
      CanControllerSyncJumpWidth: value=1
    ecuc boolean param value CanControllerSspOffset: value=False
    ecuc boolean param value CanControllerTxBitRateSwitch: value=False
  CanPartialNetwork
    ecuc boolean param value CanPnEnabled: value=False
    ecuc numerical param value CanPnFrameCanId: value=0
    ecuc numerical param value CanPnFrameCanIdMask: value=0
    ecuc numerical param value CanPnFrameDlc: value=8
  CanPnFrameDataMaskSpec
    ecuc numerical param value CanPnFrameDataMask: value=0
    ecuc numerical param value CanPnFrameDataMaskIndex: value=0
  CanHardwareObject
    ecuc numerical param value CanFdPaddingValue: value=0
    ecuc textual param value CanHandleType: value=BASIC
    ecuc boolean param value CanHardwareObjectUsesPolling: value=False
    ecuc numerical param value CanHwObjectCount: value=1
    ecuc textual param value CanIdType: value=STANDARD
    ecuc numerical param value CanObjectId: value=0
    ecuc textual param value CanObjectPayloadLength: value=CAN_OBJECT_PL_8
    ecuc textual param value CanObjectType: value=RECEIVE
    ecuc boolean param value CanTriggerTransmitEnable: value=False
  CanHwFilter
    ecuc numerical param value CanHwFilterCode: value=0
    ecuc numerical param value CanHwFilterMask: value=0
  CanMainFunctionRWPeriods
    ecuc numerical param value CanMainFunctionPeriod: value=0
  CanTTController
    ecuc numerical param value CanTTControllerApplWatchdogLimit: value=0
    ecuc numerical param value CanTTControllerCycleCountMax: value=0
    ecuc numerical param value CanTTControllerExpectedTxTrigger: value=0
    ecuc boolean param value CanTTControllerExternalClockSynchronisation: value=False
    ecuc boolean param value CanTTControllerGlobalTimeFiltering: value=False
    ecuc numerical param value CanTTControllerInitialRefOffset: value=0
    ecuc numerical param value CanTTControllerInterruptEnable: value=0
    ecuc boolean param value CanTTControllerLevel2: value=False
    ecuc numerical param value CanTTControllerNTUConfig: value=0
    ecuc textual param value CanTTControllerOperationMode: value=CAN_TT_TIME_TRIGGERED
    ecuc numerical param value CanTTControllerSyncDeviation: value=0
    ecuc boolean param value CanTTControllerTimeMaster: value=False
    ecuc numerical param value CanTTControllerTimeMasterPriority: value=0
    ecuc boolean param value CanTTControllerTURRestore: value=False
    ecuc numerical param value CanTTControllerTxEnableWindowLength: value=0
    ecuc numerical param value CanTTControllerWatchTriggerGapTimeMark: value=0
    ecuc numerical param value CanTTControllerWatchTriggerTimeMark: value=0
    ecuc textual param value CanTTIRQProcessing: value=INTERRUPT
  CanTTHardwareObjectTrigger
    4 x ecuc numerical param value, all with value=0:
      CanTTHardwareObjectBaseCycle
      CanTTHardwareObjectCycleRepetition
      CanTTHardwareObjectTimeMark
      CanTTHardwareObjectTriggerId
    ecuc textual param value CanTTHardwareObjectTriggerType: value=CAN_TT_TX_TRIGGER_SINGLE
  CanXLGeneral
    ecuc boolean param value CanXLEthGlobalTimeSupport: value=False
  CanXLController
    ecuc numerical param value CanXLCtrlEthDefaultPriority: value=0
    ecuc numerical param value CanXLEthDefaultQueue: value=0
    ecuc textual param value CanXLEthPhysAddress
  CanXLHardwareObject
    ecuc numerical param value CanXLObjectId: value=0
    ecuc boolean param value CanXLHwFilter: value=False
  CanXLBaudrateConfig
    ecuc numerical param value CanXLBaudRate: value=1000000
    ecuc boolean param value CanXLErrorSignaling: value=False
    8 x ecuc numerical param value:
      CanXLPropSeg: value=1
      CanXLPwmL: value=0
      CanXLPwmO: value=0
      CanXLPwmS: value=0
      CanXLSeg1: value=1
      CanXLSeg2: value=1
      CanXLSspOffset: value=0
      CanXLSyncJumpWidth: value=1
    ecuc boolean param value CanXLTrcvPwmMode: value=False
  CanXLEthEgressFifo
    ecuc numerical param value CanXLEthIngressFifoCanXLQueue: value=0
    ecuc numerical param value CanXLEthIngressFifoIdx: value=0
    ecuc numerical param value CanXLEthIngressFifoVcid: value=0
  CanIcomGeneral
    ecuc textual param value CanIcomLevel: value=CAN_ICOM_LEVEL_ONE
    ecuc textual param value CanIcomVariant: value=CAN_ICOM_VARIANT_HW
  CanIcomRxMessage
    4 x ecuc numerical param value, all with value=0:
      CanIcomCounterValue
      CanIcomMessageId
      CanIcomMessageIdMask
      CanIcomMissingMessageTimerValue
    ecuc boolean param value CanIcomPayloadLengthError: value=False
  CanIcomRxMessageSignalConfig
    ecuc numerical param value CanIcomSignalMask: value=0
    ecuc textual param value CanIcomSignalOperation: value=AND
    ecuc numerical param value CanIcomSignalValue: value=0
    ecuc boolean param value CanIcomSignalRef: value=False
