AUTOSAR XML
package /DioPackage
  module config DioConfig: definition=Dio
    DioConfigSet
      ecuc boolean param value DioConfigSetIncluded: value=true
    DioGeneral
      4 x ecuc boolean param value, all with value=True:
        DioDevErrorDetect
        DioFlipChannelApi
        DioMaskedWritePortApi
        DioVersionInfoApi
    DioPort
      ecuc numerical param value DioPortId: value=0
    DioChannel
      ecuc numerical param value DioChannelId: value=0
    DioChannelGroup
      ecuc textual param value DioChannelGroupIdentification: value=DIO_GROUP_0
      ecuc numerical param value DioPortMask: value=255
      ecuc numerical param value DioPortOffset: value=0
    DioConfig
      ecuc boolean param value DioConfig: value=True
