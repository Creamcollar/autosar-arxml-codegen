AUTOSAR XML
package /WdgPackage
  WdgConfigSet
    ecuc boolean param value WdgConfigSetIncluded: value=true
  WdgGeneral
    ecuc boolean param value WdgDevErrorDetect: value=True
    ecuc boolean param value WdgDisableAllowed: value=True
    ecuc numerical param value WdgIndex: value=0
    ecuc numerical param value WdgInitialTimeout: value=100
    ecuc numerical param value WdgMaxTimeout: value=1000
    ecuc textual param value WdgRunArea: value=RAM
    ecuc boolean param value WdgVersionInfoApi: value=True
  WdgSettingsConfig
    ecuc textual param value WdgDefaultMode: value=WDGIF_FAST_MODE
    4 x ecuc boolean param value:
      WdgExternalConfiguration: value=False
      WdgSettingsFast: value=True
      WdgSettingsOff: value=True
      WdgSettingsSlow: value=True
  WdgPublishedInformation
    ecuc textual param value WdgTriggerMode: value=DG_BOTH
