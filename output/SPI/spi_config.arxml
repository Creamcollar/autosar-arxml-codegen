AUTOSAR XML
package /SpiPackage
  SpiConfigSet
    ecuc boolean param value SpiConfigSetIncluded: value=true
  SpiDemEventParameterRefs
    ecuc boolean param value SPI_E_HARDWARE_ERROR: value=True
  SpiGeneral
    ecuc boolean param value SpiCancelApi: value=True
    ecuc numerical param value SpiChannelBuffersAllowed: value=1
    ecuc boolean param value SpiDevErrorDetect: value=True
    ecuc boolean param value SpiHwStatusApi: value=True
    ecuc boolean param value SpiInterruptibleSeqAllowed: value=False
    ecuc numerical param value SpiLevelDelivered: value=0
    ecuc numerical param value SpiMainFunctionPeriod: value=10
    ecuc boolean param value SpiSupportConcurrentSyncTransmit: value=False
    ecuc textual param value SpiUserCallbackHeaderFile
    ecuc boolean param value SpiVersionInfoApi: value=True
  SpiSequence
    ecuc boolean param value SpiInterruptibleSequence: value=False
    ecuc boolean param value SpiSeqEndNotification: value=False
    ecuc numerical param value SpiSequenceId: value=0
    ecuc boolean param value SpiJobAssignment: value=True
  SpiChannel
    ecuc numerical param value SpiChannelId: value=0
    ecuc boolean param value SpiChannelType: value=True
    4 x ecuc numerical param value:
      SpiDataWidth: value=8
      SpiDefaultData: value=0
      SpiEbMaxLength: value=1
      SpiIbNBuffers: value=1
    ecuc boolean param value SpiTransferStart: value=True
  SpiChannelList
    ecuc numerical param value SpiChannelIndex: value=0
    ecuc boolean param value SpiChannelAssignment: value=True
  SpiJob
    ecuc textual param value SpiHwUnitSynchronous: value=SYNCHRONOUS
    ecuc boolean param value SpiJobEndNotification: value=True
    ecuc numerical param value SpiJobId: value=0
    ecuc numerical param value SpiJobPriority: value=0
    ecuc boolean param value SpiDeviceAssignment: value=True
  SpiExternalDevice
    ecuc numerical param value SpiBaudrate: value=1000000
    5 x ecuc textual param value:
      SpiCsBehavior: value=CS_KEEP_ASSERTED
      SpiCsIdentifier: value=CS0
      SpiCsPolarity: value=HIGH
      SpiCsSelection: value=CS_VIA_GPIO
      SpiDataShiftEdge: value=LEADING
    ecuc boolean param value SpiEnableCs: value=True
    ecuc textual param value SpiHwUnit: value=CSIB0
    ecuc textual param value SpiShiftClockIdleLevel: value=HIGH
    ecuc numerical param value SpiTimeClk2Cs: value=10
    ecuc numerical param value SpiTimeCs2Clk: value=10
    ecuc numerical param value SpiTimeCs2Cs: value=10
  SpiDriver
    ecuc numerical param value SpiMaxChannel: value=0
    ecuc numerical param value SpiMaxJob: value=0
    ecuc numerical param value SpiMaxSequence: value=0
  SpiPublishedInformation
    ecuc numerical param value SpiMaxHwUnit: value=0
